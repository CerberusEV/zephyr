## subsys/usb/device_next/class/Kconfig.cdc_ncm
```kconfig
# Copyright (c) 2024 Nordic Semiconductor ASA
#
# SPDX-License-Identifier: Apache-2.0

config USBD_CDC_NCM_CLASS
	bool "USB CDC NCM implementation"
	default y
	depends on NET_L2_ETHERNET
	depends on DT_HAS_ZEPHYR_CDC_NCM_ETHERNET_ENABLED
	help
	  USB CDC Network Control Model (NCM) implementation

if USBD_CDC_NCM_CLASS

config USBD_CDC_NCM_MAX_DGRAM_PER_NTB
	int "Max number of received datagrams per NTB"
	range 0 $(UINT16_MAX)
	default 2
	help
	  How many datagrams we are able to receive per NTB.

config USBD_CDC_NCM_SUPPORT_NTB32
	bool "Support NTB32 format"
	help
	  Enable support for NTB32 format which allows larger
	  packet sizes.

config USBD_CDC_NCM_HWINFO_MAC
	bool "Derive the host-side NCM MAC from HWINFO"
	depends on HWINFO
	help
	  Personalize the host-side MAC address (the iMACAddress string the USB
	  host adopts for its virtual NCM adapter) per device by replacing the low
	  three octets of the devicetree remote-mac-address with bytes from the
	  SoC unique ID. Without this, every unit presents the same fixed
	  remote-mac-address, so two identical devices on one host enumerate with
	  the same adapter MAC and therefore the same IPv6 link-local address.

module = USBD_CDC_NCM
module-str = usbd cdc_ncm
source "subsys/logging/Kconfig.template.log_config"

endif
```
